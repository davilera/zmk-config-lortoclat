## boards/shields/18teclat/Kconfig.defconfig
```kconfig
if SHIELD_18TECLAT

config ZMK_BLE
		default y

config ZMK_USB
		default y

config ZMK_KEYBOARD_NAME
    default "18 TECLAT"

endif
```

## boards/shields/lortoclat/Kconfig.defconfig
```kconfig
if SHIELD_LORTOCLAT

config ZMK_USB
		default y

config ZMK_KEYBOARD_NAME
    default "LORTOCLAT"

endif
```
